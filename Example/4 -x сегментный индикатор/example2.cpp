// 	Модифицируем код для отображения цифр:
int anodPins[] = {A1, A2, A3, A4}; // Задаем пины для кажого разряда
int segmentsPins[] = {5, 6, 7, 8, 9, 10, 11, 12}; //Задаем пины для каждого сегмента (из 7 + 1(точка))

void setup() {
  // Все выходы программируем как OUTPUT
  for (int i = 0; i < 4; i++) {
    pinMode(anodPins[i], OUTPUT);
  }
  for (int i = 0; i < 8; i++) {
    pinMode(segmentsPins[i], OUTPUT);
  }
}

//{A, B, C, D, E, F, G,DP} - распиновка сегментов
int seg[10][8] = {
  {1, 1, 1, 1, 1, 1, 0, 0}, //Цифра 0
  {0, 1, 1, 0, 0, 0, 0, 0}, //Цифра 1
  {1, 1, 0, 1, 1, 0, 1, 0}, //Цифра 2
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  {1, 1, 1, 1, 0, 1, 1, 0}  //Цифра 9
};

int t = 0;
int digid = 0;
void loop() {
  t += 1;
  if (t > 9999) t = 0;
  if ((t % 1000) == 0) {
    digid = t / 1000; //Каждую секунду отображаем цифры подряд
  }
  for (int i = 0; i < 4; i++) { // Каждый разряд по очереди
    for (int k = 0; k < 8; k++) {// Каждый сегмент по очереди - исходя из заданной карты
      digitalWrite(segmentsPins[k], ((seg[digid][k] == 1) ? LOW : HIGH));
    }
    digitalWrite(anodPins[i], HIGH);
    delay(1); 
    digitalWrite(anodPins[i], LOW); 
  }
}